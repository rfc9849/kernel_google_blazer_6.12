## Kconfig
```kconfig
# SPDX-License-Identifier: GPL-2.0
#
# For a description of the syntax of this configuration file,
# see Documentation/kbuild/kconfig-language.rst.
#
mainmenu "Linux/$(ARCH) $(KERNELVERSION) Kernel Configuration"

source "scripts/Kconfig.include"

source "init/Kconfig"

source "kernel/Kconfig.freezer"

source "fs/Kconfig.binfmt"

source "mm/Kconfig"

source "net/Kconfig"

source "drivers/Kconfig"

source "fs/Kconfig"

source "security/Kconfig"

source "crypto/Kconfig"

source "lib/Kconfig"

source "lib/Kconfig.debug"

source "Documentation/Kconfig"

choice
	prompt "Google SoC Kconfig.ext to use"
	default KCONFIG_EXT_NONE

config KCONFIG_EXT_NONE
	bool "None"

config KCONFIG_EXT_LGA
	bool "Tensor G5 (lga)"

endchoice

if KCONFIG_EXT_LGA
source "google-devices/lga/Kconfig.ext.lga"
source "google-devices/muzel/Kconfig.ext.muzel"
endif
```
